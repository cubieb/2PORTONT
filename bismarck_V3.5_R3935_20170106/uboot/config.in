## sdk/rtk_voip/aipc_char/Kconfig
```kconfig
menu "RTL8686 IPC"

# ---------------------------------------------------------------------
# IPC ASIC or FPGA config

comment "IPC ASIC or FPGA config"

menu "RTL8686 ASIC or FPGA"
choice 
	prompt "RTL8686 Chip Type"
	default y

config RTL8686_ASIC
	bool  "Support for RTL8686_ASIC"
	default y

config RTL8686_FPGA
	bool  "Support for RTL8686_FPGA"
	default n

endchoice

menu "RTL8686 Test IP"

config RTL8686_TEST_IP
	bool "RTL8686 TEST IP"
	default n

config RTL8686_ASIC_TEST_IP
	bool  "Support for RTL8686_ASIC_TEST_IP"
	depends on RTL8686_TEST_IP
	default n

config RTL8686_FPGA_TEST_IP
	bool  "Support for RTL8686_FPGA_TEST_IP"
	depends on RTL8686_TEST_IP
	default n

endmenu

endmenu

# ---------------------------------------------------------------------
# IPC Main Function

comment "IPC Main Function"

menu "RTL8686 IPC interface"
config RTL8686_IPC_DEV
	bool "RTL8686 IPC interface"
	default n

config RTL8686_IPC_PROCESSOR
    int "RTL8686 IPC processor"
    default 0
    depends on RTL8686_IPC_DEV

config RTL8686_IPC_SINGLE_CPU
    bool "RTL8686 IPC Single CPU "
    default n
    depends on RTL8686_IPC_DEV

config RTL8686_IPC_DUAL_LINUX
    bool "RTL8686 Dual Linux"
    default n
    depends on RTL8686_IPC_DEV
#   depends on RTL8686_IPC_DEV && LUNA_DUAL_LINUX

config RTL8686_IPC_DEBUG_MESSAGE
    bool "RTL8686 IPC debug message"
	depends on RTL8686_IPC_DEV
	default y

# config RTL8686_SHM_NOTIFY
# 	bool  "RTL8686 Shared memory notify"
# 	depends on RTL8686_IPC_DEV 
# 	default n

config RTL8686_IPC_INT_NOTIFY_CPU2DSP
	bool  "RTL8686 IPC Interrupt Notify CPU to DSP"
	depends on RTL8686_IPC_DEV && RTL8686_IPC_PROCESSOR = 0
	default n

# ---------------------------------------------------------------------
# IPC Shared Memory Setting
#
#comment "RTL8686 IPC Shared Memory Setting"
#depends on RTL8686_IPC_DEV && RTL8686_IPC_PROCESSOR = 1
#
#menu "RTL8686 SHM Setting"
#depends on RTL8686_IPC_DEV && RTL8686_IPC_PROCESSOR = 1
#
#config RTL8686_SHM_SETTING
#	bool "RTL8686 SHM Setting"
#	depends on RTL8686_IPC_DEV && RTL8686_IPC_PROCESSOR = 1
#	default y
#
#config RTL8686_CPU_MEM_BASE
#	hex  "RTL8686 CPU MEM Base"
#	depends on RTL8686_SHM_SETTING
#	default 0x00000000
#
#config RTL8686_CPU_MEM_SIZE
#	hex  "RTL8686 CPU MEM Size"
#	depends on RTL8686_SHM_SETTING && RTL8686_IPC_PROCESSOR = 1
#	default 0x03800000
#
#config RTL8686_IPC_MEM_BASE
#	hex  "RTL8686 IPC MEM Base"
#	depends on RTL8686_SHM_SETTING && RTL8686_IPC_PROCESSOR = 1
#	default 0x03800000
#
#config RTL8686_IPC_MEM_SIZE
#	hex  "RTL8686 IPC MEM Size"
#	depends on RTL8686_SHM_SETTING && RTL8686_IPC_PROCESSOR = 1
#	default 0x00100000
#
#config RTL8686_DSP_MEM_BASE
#	hex  "RTL8686 DSP MEM Base"
#	depends on RTL8686_SHM_SETTING && RTL8686_IPC_PROCESSOR = 1
#	default 0x03900000
#
#config RTL8686_DSP_MEM_SIZE
#	hex  "RTL8686 DSP MEM Size"
#	depends on RTL8686_SHM_SETTING && RTL8686_IPC_PROCESSOR = 1
#	default 0x00700000
#
#endmenu

# # ---------------------------------------------------------------------
# # UART1 Enable/Disable
# 
# comment "UART1 Enable/Disable"
# 
# config RTL8686_IPC_UART1_ENABLE
# 	bool "RTL8686 IPC UART1 Enable"
# 	depends on RTL8686_IPC_DEV && RTL8686_IPC_PROCESSOR = 0
# 	default n
# 	help
# 		Enable UART1 for DSP access

# # ---------------------------------------------------------------------
# # CPU1 UART Selection
# 
# comment "CPU1 UART Selection"
# config CPU1_DSP_SELECTION
# choice
# 	prompt "CPU1 UART Selection"
# 	default CPU1_DIS_UART
# 	help
# 		CPU1 UART Selection
# config CPU1_UART0
#         bool "Use UART0"
#         help
#                 CPU1 Use UART0
# config CPU1_UART1
# 	bool "Use UART1"
# 	help
#                 CPU1 Use UART1
# config CPU1_UART2
#         bool "Use UART2"
#         help
#                 CPU1 Using UART2
# config CPU1_UART3
# 	bool "Use UART3"
# 	help
# 		CPU1 Use UART3
# config CPU1_DIS_UART
#         bool "Disable"
#         help
# 		CPU1 Disable UART
# endchoice
# 
# config CPU1_UART_BASE_ADDR
# 	hex
# 	default 0xB8002000 if CPU1_UART0
# 	default 0xB8002100 if CPU1_UART1
# 	default 0xB8002200 if CPU1_UART2
# 	default 0xB8002300 if CPU1_UART3
# 	default 0          if CPU1_DIS_UART
# ---------------------------------------------------------------------
# SLIC Reset 

comment "RTL8686 SLIC Reset"

config RTL8686_SLIC_RESET
	bool "RTL8686 SLIC RESET"
	depends on RTL8686_IPC_DEV && RTL8686_IPC_PROCESSOR = 0
	default n

config RTL8686_SLIC_RESET_GPIO_NUM
	int "RTL8686 SLIC RESET GPIO NUM"
	depends on RTL8686_SLIC_RESET
	default 17
	range 0 64


# ---------------------------------------------------------------------
# DSP Console

comment "DSP Console"

config RTL8686_IPC_DSP_CONSOLE
	bool "RTL8686 IPC DSP Console"
	depends on RTL8686_IPC_DEV
	default y
	help
		Access DSP Console in CPU side. 

# ---------------------------------------------------------------------
# IPC Index Use SRAM or DRAM

comment "IPC Index use SRAM or DRAM"
	depends on RTL8686_IPC_DEV

config RTL8686_IPC_IDX_USE_DRAM
	bool "RTL8686 IPC Index Use DRAM"
	depends on RTL8686_IPC_DEV
	default y

config RTL8686_IPC_IDX_USE_SRAM
	bool "RTL8686 IPC Index Use SRAM"
	depends on RTL8686_IPC_DEV && !RTL8686_IPC_IDX_USE_DRAM
	default n

config RTL8686_IPC_DSP_BOOTING_ADDRESS
	hex  "RTL8686 IPC DSP Booting Address"
	depends on RTL8686_IPC_IDX_USE_DRAM || RTL8686_IPC_IDX_USE_SRAM
	default 0x88000000
	help
		Suggest value
			Use DRAM 0x88000000
			Use SRAM 0xbf100000


# ---------------------------------------------------------------------
# IPC DSP Setting

comment "IPC DSP Config"
	depends on RTL8686_IPC_DEV

config RTL8686_IPC_DSP_CONFIG
	bool "RTL8686 IPC DSP Config"
	depends on RTL8686_IPC_DEV
	default y

config RTL8686_IPC_DSP_CONFIG_CON_CH_NUM
	int "RTL8686 IPC DSP Control Channel Number"
	depends on RTL8686_IPC_DEV && RTL8686_IPC_PROCESSOR = 0 && RTL8686_IPC_DSP_CONFIG
	default 2
	range 1 3 

config RTL8686_IPC_DSP_CONFIG_MIRROR_SLIC_NR
	int "RTL8686 IPC DSP Mirror SLIC Number"
	depends on RTL8686_IPC_DEV && RTL8686_IPC_PROCESSOR = 0 && RTL8686_IPC_DSP_CONFIG
	default 2
	range 1 2

# ---------------------------------------------------------------------
# DSL IPC

comment "DSL IPC"
	depends on RTL8686_IPC_DEV

config RTL8686_IPC_DSL_IPC
	bool "RTL8686 IPC DSL IPC"
	depends on RTL8686_IPC_DEV && RTL8686_IPC_DUAL_LINUX
	default n

# ---------------------------------------------------------------------
# IPC Debug  

comment "IPC Debug"

config RTL8686_IPC_RECORD_DSP_LOG
	bool "RTL8686 IPC Record DSP log"
	depends on RTL8686_IPC_DEV
	default y
	help
		Get DSP console logs from CPU side. 

# ---------------------------------------------------------------------
# IPC Test Codes

comment "IPC Test Codes"

config RTL8686_IPC_TEST_THREAD
    bool "RTL8686 IPC test thread"
    default n
    depends on RTL8686_IPC_DEV

config RTL8686_IPC_TEST_THREAD_2
    bool "RTL8686 IPC test thread 2"
    default n
    depends on RTL8686_IPC_TEST_THREAD

config RTL8686_IPC_TEST_THREAD_3
    bool "RTL8686 IPC test thread 3"
    default n
    depends on RTL8686_IPC_TEST_THREAD_2


comment "RTL8686 DSP LED Test"
	depends on RTL8686_IPC_DEV
	#depends on RTL8686_IPC_DEV && (RTL8686_IPC_PROCESSOR != 0)

config RTL8686_DSP_LED_TEST
	bool "RTL8686 DSP LED Test"
	depends on RTL8686_IPC_DEV
	default n

config RTL8686_DSP_LED_GPIO_NUM
	int "RTL8686 DSP LED GPIO NUM"
	depends on RTL8686_DSP_LED_TEST
	default 34
	range 0 64


comment "RTL8686 IPC DSL IPC Test Codes"
	depends on RTL8686_IPC_DSL_IPC

config RTL8686_IPC_DSL_IPC_TEST
    bool "RTL8686 IPC test"
    default n
    depends on RTL8686_IPC_DSL_IPC

#config RTL8686_IPC_DSL_IPC_TEST_THREAD
#    bool "RTL8686 IPC test thread"
#    default n
#    depends on RTL8686_IPC_DSL_IPC_TEST

endmenu

endmenu
```

## sdk/rtk_voip/kernel/Kconfig.DSP
```kconfig
# ---------------------------------------------------------------------
# DSP
		
comment "DSP options"
		
config AUDIOCODES_VOIP_
	bool 
	default y
	depends on RTK_VOIP_DRIVERS_PCM8981B_ || RTK_VOIP_DRIVERS_PCM8982B_ || RTK_VOIP_DRIVERS_PCM8984B_ ||	\
		RTK_VOIP_DRIVERS_PCM8961C_ || RTK_VOIP_DRIVERS_PCM8962C_ || RTK_VOIP_DRIVERS_PCM8964C_ ||	\
		RTK_VOIP_DRIVERS_PCM8672 || RTK_VOIP_DRIVERS_PCM8676
		
choice
	prompt "DSP package" 
	default AUDIOCODES_VOIP if AUDIOCODES_VOIP_
		
config REALTEK_VOIP
	bool "Realtek"
			
config AUDIOCODES_VOIP
	bool "Audiocodes"
	depends on AUDIOCODES_VOIP_

endchoice

config AUDIOCODES_VOIP_RELEASE
	bool
	default y
	depends on AUDIOCODES_VOIP
		
config	RTK_VOIP_IVR
	bool
	default y
	select RTK_VOIP_IVR_TEXT
	select RTK_VOIP_IVR_LINEAR_8K
	select RTK_VOIP_IVR_DEV

config	RTK_VOIP_IVR_DEV
	bool 

config	RTK_VOIP_IVR_TEXT
	bool 

config	RTK_VOIP_IVR_LINEAR_8K
	bool 

#config	RTK_VOIP_IVR_LINEAR_16K
#	bool "Linear 16kHz"

source "rtk_voip/Kconfig.DSP.codec"
```

## sdk/rtk_voip/kernel/Kconfig.DSP.codec
```kconfig
# ---------------------------------------------------------------------
# DSP - codec  
		
comment "Speech CODECs"

config	RTK_VOIP_G729AB
	def_bool y

config	RTK_VOIP_G7231
	def_bool y

config	RTK_VOIP_AMR_NB
	def_bool n
	depends on REALTEK_VOIP

config	RTK_VOIP_RTK_VOIP_SPEEX_NB
	def_bool n
	depends on REALTEK_VOIP

config 	RTK_VOIP_G726
	def_bool y
	depends on REALTEK_VOIP

config	RTK_VOIP_GSMFR
	def_bool y
	depends on REALTEK_VOIP

config  RTK_VOIP_ILBC
	def_bool y
	depends on REALTEK_VOIP

config	RTK_VOIP_G722
	def_bool y
	depends on REALTEK_VOIP

config	RTK_VOIP_G7111
	def_bool n
	depends on REALTEK_VOIP

config	RTK_VOIP_T38
	def_bool y
		
config	RTK_VOIP_PCM_LINEAR_8K
	bool
	default n
		
config	RTK_VOIP_PCM_LINEAR_16K
	bool
	default n
		
config	RTK_VOIP_SILENCE
	bool
	default y

config RTK_VOIP_USE_ITUT_G7111_BASOP
	bool
	default n
	depends on RTK_VOIP_G7111

config RTK_VOIP_USE_ITU_G722_BASOP
	bool
	default n
	depends on RTK_VOIP_G722

config RTK_VOIP_G722_ITU_USE
	bool
	default y
	depends on RTK_VOIP_G722
```

## sdk/vendors/config.in
```kconfig
mainmenu_name 'uClinux Configuration'
mainmenu_option next_comment
comment 'Target Platform Selection'
comment 'Choose a Vendor/Product combination.'
choice 'Vendor/Product' "3com/PalmIIIx CONFIG_DEFAULTS_3COM_PALMIIIX \
3com/Xcopilot CONFIG_DEFAULTS_3COM_XCOPILOT \
Arcturus/uC5272 CONFIG_DEFAULTS_ARCTURUS_UC5272 \
Arcturus/uCdimm CONFIG_DEFAULTS_ARCTURUS_UCDIMM \
Arcturus/uCquicc CONFIG_DEFAULTS_ARCTURUS_UCQUICC \
Arcturus/uCsimm CONFIG_DEFAULTS_ARCTURUS_UCSIMM \
Arnewsh/M5206 CONFIG_DEFAULTS_ARNEWSH_M5206 \
Arnewsh/M5307 CONFIG_DEFAULTS_ARNEWSH_M5307 \
Atmel/AT91 CONFIG_DEFAULTS_ATMEL_AT91 \
Conexant/P52 CONFIG_DEFAULTS_CONEXANT_P52 \
Cytek/NETmp3 CONFIG_DEFAULTS_CYTEK_NETMP3 \
Exys/de2 CONFIG_DEFAULTS_EXYS_DE2 \
Feith/Cleopatra2 CONFIG_DEFAULTS_FEITH_CLEOPATRA2 \
Feith/Cleopatra CONFIG_DEFAULTS_FEITH_CLEOPATRA \
GDB/ARMulator CONFIG_DEFAULTS_GDB_ARMULATOR \
GDB/ARMulator-EB CONFIG_DEFAULTS_GDB_ARMULATOR_EB \
Hitachi/BigSurIV CONFIG_DEFAULTS_HITACHI_BIGSURIV \
Hitachi/KeyWest CONFIG_DEFAULTS_HITACHI_KEYWEST \
Intel/IXDP425 CONFIG_DEFAULTS_INTEL_IXDP425 \
LEOX/TSIM CONFIG_DEFAULTS_LEOX_TSIM \
Mecel/FR1000 CONFIG_DEFAULTS_MECEL_FR1000 \
Midas/RTE-V850E-MA1-CB CONFIG_DEFAULTS_MIDAS_RTE_V850E_MA1_CB \
Motorola/M5206eC3 CONFIG_DEFAULTS_MOTOROLA_M5206EC3 \
Motorola/M5206eLITE CONFIG_DEFAULTS_MOTOROLA_M5206ELITE \
Motorola/M5249C3 CONFIG_DEFAULTS_MOTOROLA_M5249C3 \
Motorola/M5272C3 CONFIG_DEFAULTS_MOTOROLA_M5272C3 \
Motorola/M5307C3 CONFIG_DEFAULTS_MOTOROLA_M5307C3 \
Motorola/M5407C3 CONFIG_DEFAULTS_MOTOROLA_M5407C3 \
NEC/v850e-sim-gdb CONFIG_DEFAULTS_NEC_V850E_SIM_GDB \
Netburner/CFV240 CONFIG_DEFAULTS_NETBURNER_CFV240 \
NetSilicon/NET+ARM CONFIG_DEFAULTS_NETSILICON_NET_ARM \
OPENcores/or32 CONFIG_DEFAULTS_OPENCORES_OR32 \
Promise/SX6 CONFIG_DEFAULTS_PROMISE_SX6 \
Samsung/4510B CONFIG_DEFAULTS_SAMSUNG_4510B \
SecureEdge/DISKtel CONFIG_DEFAULTS_SECUREEDGE_DISKTEL \
SecureEdge/eLIA CONFIG_DEFAULTS_SECUREEDGE_ELIA \
SecureEdge/MP3 CONFIG_DEFAULTS_SECUREEDGE_MP3 \
SecureEdge/NETtel1500 CONFIG_DEFAULTS_SECUREEDGE_NETTEL1500 \
SecureEdge/NETtel3540 CONFIG_DEFAULTS_SECUREEDGE_NETTEL3540 \
SecureEdge/SecureEdge1100 CONFIG_DEFAULTS_SECUREEDGE_SECUREEDGE1100 \
SecureEdge/SecureEdge2540 CONFIG_DEFAULTS_SECUREEDGE_SECUREEDGE2540 \
SecureEdge/SecureEdge2570 CONFIG_DEFAULTS_SECUREEDGE_SECUREEDGE2570 \
SecureEdge/SecureEdge2580 CONFIG_DEFAULTS_SECUREEDGE_SECUREEDGE2580 \
SecureEdge/SecureEdge2580-JFFS CONFIG_DEFAULTS_SECUREEDGE_SECUREEDGE2580_JFFS \
SecureEdge/SecureEdgeEdna CONFIG_DEFAULTS_SECUREEDGE_SECUREEDGEEDNA \
SecureEdge/SecureEdgeNAS CONFIG_DEFAULTS_SECUREEDGE_SECUREEDGENAS \
SecureEdge/SecureEdgePCMCIA CONFIG_DEFAULTS_SECUREEDGE_SECUREEDGEPCMCIA \
SecureEdge/SecureEdgeVPN CONFIG_DEFAULTS_SECUREEDGE_SECUREEDGEVPN \
senTec/COBRA5272 CONFIG_DEFAULTS_SENTEC_COBRA5272 \
SnapGear/LITE CONFIG_DEFAULTS_SNAPGEAR_LITE \
SnapGear/PRO CONFIG_DEFAULTS_SNAPGEAR_PRO \
SnapGear/SME530 CONFIG_DEFAULTS_SNAPGEAR_SME530 \
SnapGear/SME550 CONFIG_DEFAULTS_SNAPGEAR_SME550 \
SnapGear/SOHO+ CONFIG_DEFAULTS_SNAPGEAR_SOHO_ \
SWARM/SWARM CONFIG_DEFAULTS_SWARM_SWARM \
TeleIP/rsc CONFIG_DEFAULTS_TELEIP_RSC \
Via/EPIA CONFIG_DEFAULTS_VIA_EPIA \
" SecureEdge/SecureEdgeVPN
comment 'Kernel is linux-2.4.x'
define_bool CONFIG_DEFAULTS_KERNEL_2_4 y
choice 'Libc Version' "uC-libc CONFIG_DEFAULTS_LIBC_UC_LIBC \
uClibc-0.9.15 CONFIG_DEFAULTS_LIBC_UCLIBC_0_9_15 \
" uClibc-0.9.15
bool 'Default all settings (lose changes)'	CONFIG_DEFAULTS_OVERRIDE
bool 'Customize Kernel Settings'			CONFIG_DEFAULTS_KERNEL
bool 'Customize Vendor/User Settings'		CONFIG_DEFAULTS_VENDOR
bool 'Update Default Vendor Settings'		CONFIG_DEFAULTS_VENDOR_UPDATE
endmenu
```
