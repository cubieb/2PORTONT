## sdk/linux-2.6.x/drivers/net/rtl86900/sdk/Kconfig
```kconfig
# RTL86900 SDK configuration
#

config	MODULE_BUILD_IN
	tristate "Realtek RTL86900 SDK"
	default y
	help

	   To compile it as a module, choose M here.  If unsure, say N.

config SDK_MODULES
	bool "Support RTK Apollo Modules"
	help
	   Say Y if you want to enable RTK Apollo modules.

config GPON_FEATURE
        bool "Support RTK GPON"
        depends on SDK_MODULES
        help
          Say Y if your machine has pon phy port.

config RTK_OMCI_V1
        bool "Support RTK OMCI V1"
        depends on GPON_FEATURE
        help
          Choice for enable RTK OMCI V1.

config GPON_ROGUE_SELF_DETECT
        bool "Support GPON rogue ONU self detect"
        depends on GPON_FEATURE
	default n
        help
          Choice for enable GPON rogue self detection.

config RTK_IGMP
		bool "Support RTK IGMP"
		depends on SDK_MODULES
        help
          Say Y if you want to enable RTK IGMP.

config RLDP_FEATURE
    	bool "Support RTK RLDP"
    	depends on SDK_MODULES
        help
          Say Y if you want to enable RTK RLDP.

config OE_RESET_AFTER_TX_DIS_OFF
        bool "Reset OE module"
        depends on GPON_FEATURE
        default n
        help
          Choice for enable mechanism for reset OE module after turn off tx_disable.

config EPON_FEATURE
    	bool "Support RTK EPON"
    	depends on SDK_MODULES
        help
          Say Y if your machine has EPON phy ports.

config RTK_OAM_V1
	bool "Support RTK OAM V1"
        depends on EPON_FEATURE
	default y
	help
	  Choice for enable RTK OAM V1

config EPON_LOS_RECOVER
		bool "Support EPON LOS recover"
		depends on RTK_OAM_V1
		default n

config EPON_OAM_DUMMY_MODE
		bool "Support EPON OAM dummy mode"
		depends on RTK_OAM_V1
		default n

config PON_DETECT_FEATURE
    	bool "Support GPON/EPON detect"
    	depends on GPON_FEATURE && EPON_FEATURE
        default y
        help
          Say Y if your machine has GPON/EPON detect function.

config PON_AUTO_SELECT_FEATURE
    	bool "Support GPON/EPON auto selection"
    	depends on PON_DETECT_FEATURE
        default n
        help
          Say Y if your machine has GPON/EPON auto selection function.

config FIBER_FEATURE
        bool "Support RTK FIBER"
        depends on SDK_MODULES
        help
          Say Y if your machine has FIBER phy ports.

choice
	prompt "Fiber speed AN/force mode for force 1G, force 100M or auto detect"
	depends on FIBER_FEATURE
	default FIBER_SPEED_AUTO

config FIBER_SPEED_1G
	bool "AN 1G only"

config FIBER_SPEED_100M
	bool "AN 100M only"

config FIBER_SPEED_AUTO
	bool "Auto 100M/1G"

config FIBER_SPEED_FORCE_1G
	bool "Force 1G"

config FIBER_SPEED_FORCE_100M
	bool "Force 100M"

config FIBER_SW_AUTO_DETECT
	bool "Software detect"

endchoice

choice
	prompt "Fiber module detection method, SD output level or fiber signal"
	depends on FIBER_FEATURE
	default FIBER_DETECT_SD

config FIBER_DETECT_OOBS
	bool "OOBS"

config FIBER_DETECT_SD
	bool "SD"
endchoice

choice
	prompt "Fiber module output signal detect(SD) or loss"
	depends on FIBER_FEATURE && FIBER_DETECT_SD
	default FIBER_MODULE_LOSS

config FIBER_MODULE_LOSS
	bool "Loss"

config FIBER_MODULE_SD
	bool "SD"
endchoice

config DYING_GASP_FEATURE
        bool "Support RTK DYING GASP of ETHER or FIBER"
        depends on SDK_MODULES && !(GPON_FEATURE || EPON_FEATURE)
        help
          Say Y if your machine want dying gasp in fiber or ether WAN.

config PBO_MEM_USAGE
	int "DRAM size in MB for PBO usage"
	range 0 8
	depends on RTL9601B_SERIES
	default "8"
	help
	  Causion! this value will correlate with the memory size and the kernel memory in CONFIG_CMDLINE

config TX_DISABLE_GPIO_PIN
	int "gpio pin for disable tx"
	range 0 71
	depends on SDK_MODULES
	default "34"
	help
	      the GPIO pin for disable tx

config TX_POWER_TURN_ON_FEATURE
    	bool "Support GPON/EPON Turn On TX Power"
    	depends on GPON_FEATURE && EPON_FEATURE
        default n
        help
          Say Y if your board is default turn off TX power and want GPON/EPON turn on TX power in intial state.

config TX_POWER_GPO_PIN
	int "gpio pin for TX power"
	range 0 71
	depends on TX_POWER_TURN_ON_FEATURE
	default "0"
	help
	      the GPIO pin for TX power

config RTK_L34_DEMO
        tristate "Support RTK L34 Lite Auto Learning"
        depends on SDK_MODULES && !RTK_L34_ENABLE
        default m
	help
          Choice for enable L34 Lite Auto Learning mechanism.

config RTK_FT2_MODULE
        bool "Support RTK FT2 module"
        depends on SDK_MODULES
        help
          Choice for enable Factory Test module.

config EUROPA
        tristate "Support Europa module"
        depends on SDK_MODULES
	default n
  	help
          Choice for enable Europa module.          
choice
	prompt "Support EUROPA control using I2C port 0 or port 1"
	depends on EUROPA
	default EUROPA_I2C_PORT_0

config EUROPA_I2C_PORT_0
	bool "I2C port 0"

config EUROPA_I2C_PORT_1
	bool "I2C port 1"
endchoice                  
 
config EUROPA_FEATURE
        bool "Support EUROPA driver and diagshell"
        depends on EUROPA
	default n
        help
          Choice for enable EUROPA feature.

config EUROPA_INTERRUPT
        bool "Support EUROPA interrupt"
        depends on EUROPA_FEATURE
	default n
        help
          Choice for enable EUROPA interrupt.

config EUROPA_INTERRUPT_GPIO_PIN
	int "gpio pin for Europa interrupt"
	range 0 71
	depends on EUROPA_INTERRUPT
	default "13"
	help
          GPIO pinf for interrup.

config EXTERNAL_PHY_POLLING
	bool "Support Switch External PHY Polling using asic mdc/mdio"
	default n
	help
          Choice for enable external phy polling with asic mdc/mdio.

config EXTERNAL_PHY_POLLING_USING_GPIO
	bool "Support Switch External PHY Polling using GPIO"
	default n
        depends on !EXTERNAL_PHY_POLLING
        default n
	help
          Choice for enable external phy polling with GPIO emulation mdc/mdio.

config EXTERNAL_PHY_MII_CLOCK_GPIO_PIN
	int "gpio pin for MII clock"
	range 0 71
	depends on EXTERNAL_PHY_POLLING_USING_GPIO
	default "60"
	help
	      the GPIO pin for external phy MII clock pin

config EXTERNAL_PHY_MII_DATA_GPIO_PIN
	int "gpio pin for MII data"
	range 0 71
	depends on EXTERNAL_PHY_POLLING_USING_GPIO
	default "61"
	help
	      the GPIO pin for external phy MII data pin

choice
        prompt "Select the target board profile for LED display"
        depends on FIBER_FEATURE || GPON_FEATURE || EPON_FEATURE
        default PON_LED_PROFILE_DEMO_RTL9607

config PON_LED_PROFILE_DEMO_RTL9607
	bool "RTL9607 demo board"

config PON_LED_PROFILE_DEMO_RTL9607_IAD_V00
	bool "RTL9607 demo board for IAD v0.0"

config PON_LED_PROFILE_DEMO_RTL9601
	bool "RTL9601 demo board"

config PON_LED_PROFILE_DEMO_RTL9601B
	bool "RTL9601B demo board"

config PON_LED_PROFILE_DEMO_RTL9602B
	bool "RTL9602B demo board"

config PON_LED_PROFILE_DEMO_RTL9602C
	bool "RTL9602C demo board"

config PON_LED_PROFILE_DEMO_RTL9607P
	bool "RTL9607P demo board"

config PON_LED_PROFILE_001
	bool "Board profile #001"

endchoice

config SWITCH_INIT_LINKDOWN
    bool "switch init default link down"
 	default n
    help
        Say Y if switch driver will linkdown switch port by default.

config REDUCED_DIAG
        bool "Reduce some diag shell command for specific condition"
	default n
        depends on SDK_MODULES
        help
          Say Y if you would like to use reduced diag shell, most of the case this SHOULD NOT be selected

config LAN_SDS_FEATURE
	bool "Support LAN serdes feature"
	default n
	depends on RTL9601B_SERIES
	help
	  Say Y if you would like to use LAN serdes feature 

config SFP_APPLICATION
	bool "Support SFP application"
	default n
	depends on LAN_SDS_FEATURE
	help
	  Say Y if you would like to run the SFP demo application

config FORCE_SDK_RTL9602B
	bool "Force chip subtype to RTL9602B"
	default n
	depends on RTL9600_SERIES
	help
	  Say Y if you would like to force asic to RTL9602B
```

## sdk/linux-2.6.x/drivers/net/rtl86900/tr142/Kconfig
```kconfig
# Realtek TR-142 Module configuration
#

config TR142_MODULE
	bool "RTK TR-142 Module"
	depends on GPON_FEATURE && RTK_L34_ENABLE
	default n
	help
	    Say Y if you want to enable RTK TR-142 Module.
```

## sdk/linux-2.6.x/drivers/net/wireless/rtl8190/Kconfig
```kconfig
config RTL8190
	tristate "Realtek 8190 wireless support"
#	depends on PCI && NET_RADIO
	---help---
	  This is an experimental driver for rtl8190 wireless chip.
config NET_WIRELESS_AGN
        bool
        depends on RTL8190
        default y
config	RTL8190_PRIV_SKB
	depends on RTL8190
	bool "private skb buffer management"
	default y
config RTL8192SE
	tristate "Realtek 8192SE wireless support"
#	depends on PCI && NET_RADIO
	---help---
	  This is an experimental driver for rtl8190 wireless chip.
config NET_WIRELESS_AGN
        bool
        depends on RTL8192SE
        default y
config	RTL_WAPI_SUPPORT	
	tristate "WAPI support"
	depends on RTL8192SE
config	RTL_WAPI_MODULE_SUPPORT
	bool "enable WAPI module"
	depends on RTL8192SE && RTL_WAPI_SUPPORT
	default n
config	RTL_4MFLASH_32MSDRAM
	bool
	depends on RTL8192SE && RTL_WAPI_SUPPORT
	default y
config	RTL_DYNAMIC_IRAM_MAPPING_FOR_WAPI 
	bool
	depends on RTL8192SE && RTL_WAPI_SUPPORT
	default y
config 	RTL_DYNAMIC_IRAM_MAPPING_FOR_WAPI_DEBUG
	bool
	depends on RTL8192SE && RTL_WAPI_SUPPORT && RTL_DYNAMIC_IRAM_MAPPING_FOR_WAPI
	default n
```

## sdk/linux-2.6.x/drivers/net/wireless/rtlmac80211Drv/Kconfig
```kconfig
config RTL8192SE_mac80211
	tristate "Realtek 8192SE wireless support mac80211"
	depends on PCI && NET_RADIO && MAC_80211 && WLAN80211
	---help---
	  This is an experimental driver for rtl8190 wireless chip.
config NET_WIRELESS_AGN
        bool
        depends on RTL8192SE_mac80211
#        default y
#config	RTL_WAPI_SUPPORT	
#	tristate "WAPI support"
#	depends on RTL8192SE
#config	RTL_WAPI_MODULE_SUPPORT
#	bool "enable WAPI module"
#	depends on RTL_WAPI_SUPPORT
#	default n
#config	RTL_4MFLASH_32MSDRAM
#	bool
#	depends on RTL_WAPI_SUPPORT
#	default y
#config	RTL_DYNAMIC_IRAM_MAPPING_FOR_WAPI 
#	bool
#	depends on RTL_WAPI_SUPPORT
#	default y
#config 	RTL_DYNAMIC_IRAM_MAPPING_FOR_WAPI_DEBUG
#	bool
#	depends on RTL_DYNAMIC_IRAM_MAPPING_FOR_WAPI
#	default n
```

## sdk/linux-2.6.x/drivers/serial/Kconfig
```kconfig
#
# Serial device configuration
#
# $Id: Kconfig,v 1.3 2011/09/01 12:27:48 tsaitc Exp $
#

menu "Serial drivers"

#
# The new 8250/16550 serial drivers
config SERIAL_8250
	tristate "8250/16550 and compatible serial support"
	select SERIAL_CORE
	---help---
	  This selects whether you want to include the driver for the standard
	  serial ports.  The standard answer is Y.  People who might say N
	  here are those that are setting up dedicated Ethernet WWW/FTP
	  servers, or users that have one of the various bus mice instead of a
	  serial mouse and don't intend to use their machine's standard serial
	  port for anything.  (Note that the Cyclades and Stallion multi
	  serial port drivers do not need this driver built in for them to
	  work.)

	  To compile this driver as a module, choose M here: the
	  module will be called 8250.
	  [WARNING: Do not compile this driver as a module if you are using
	  non-standard serial ports, since the configuration information will
	  be lost when the driver is unloaded.  This limitation may be lifted
	  in the future.]

	  BTW1: If you have a mouseman serial mouse which is not recognized by
	  the X window system, try running gpm first.

	  BTW2: If you intend to use a software modem (also called Winmodem)
	  under Linux, forget it.  These modems are crippled and require
	  proprietary drivers which are only available under Windows.

	  Most people will say Y or M here, so that they can use serial mice,
	  modems and similar devices connecting to the standard serial ports.

config SERIAL_8250_CONSOLE
	bool "Console on 8250/16550 and compatible serial port"
	depends on SERIAL_8250=y
	select SERIAL_CORE_CONSOLE
	---help---
	  If you say Y here, it will be possible to use a serial port as the
	  system console (the system console is the device which receives all
	  kernel messages and warnings and which allows logins in single user
	  mode). This could be useful if some terminal or printer is connected
	  to that serial port.

	  Even if you say Y here, the currently visible virtual console
	  (/dev/tty0) will still be used as the system console by default, but
	  you can alter that using a kernel command line option such as
	  "console=ttyS1". (Try "man bootparam" or see the documentation of
	  your boot loader (grub or lilo or loadlin) about how to pass options
	  to the kernel at boot time.)

	  If you don't have a VGA card installed and you say Y here, the
	  kernel will automatically use the first serial line, /dev/ttyS0, as
	  system console.

	  If unsure, say N.

config RTL867X_NETLOG 
	bool "netlogger 867x "
	depends on SERIAL_8250=y
config RTL8696_ICCLOG
	bool "icclogger 8696"
	depends on SERIAL_8250=y

config SERIAL_8250_NR_UARTS
	int "Maximum number of 8250/16550 serial ports"
	depends on SERIAL_8250
	default "4"
	help
	  Set this to the number of serial ports you want the driver
	  to support.  This includes any ports discovered via ACPI or
	  PCI enumeration and any ports that may be added at run-time
	  via hot-plug, or any ISA multi-port serial cards.

config SERIAL_8250_RUNTIME_UARTS
	int "Number of 8250/16550 serial ports to register at runtime"
	depends on SERIAL_8250
	range 0 SERIAL_8250_NR_UARTS
	default "4"
	help
	  Set this to the maximum number of serial ports you want
	  the kernel to register at boot time.  This can be overridden
	  with the module parameter "nr_uarts", or boot-time parameter
	  8250.nr_uarts

config SERIAL_8250_EXTENDED
	bool "Extended 8250/16550 serial driver options"
	depends on SERIAL_8250
	help
	  If you wish to use any non-standard features of the standard "dumb"
	  driver, say Y here. This includes HUB6 support, shared serial
	  interrupts, special multiport support, support for more than the
	  four COM 1/2/3/4 boards, etc.

	  Note that the answer to this question won't directly affect the
	  kernel: saying N will just cause the configurator to skip all
	  the questions about serial driver options. If unsure, say N.

config SERIAL_8250_MANY_PORTS
	bool "Support more than 4 legacy serial ports"
	depends on SERIAL_8250_EXTENDED && !IA64
	help
	  Say Y here if you have dumb serial boards other than the four
	  standard COM 1/2/3/4 ports. This may happen if you have an AST
	  FourPort, Accent Async, Boca (read the Boca mini-HOWTO, available
	  from <http://www.tldp.org/docs.html#howto>), or other custom
	  serial port hardware which acts similar to standard serial port
	  hardware. If you only use the standard COM 1/2/3/4 ports, you can
	  say N here to save some memory. You can also say Y if you have an
	  "intelligent" multiport card such as Cyclades, Digiboards, etc.

config SERIAL_8250_SHARE_IRQ
	bool "Support for sharing serial interrupts"
	depends on SERIAL_8250_EXTENDED
	help
	  Some serial boards have hardware support which allows multiple dumb
	  serial ports on the same board to share a single IRQ. To enable
	  support for this in the serial driver, say Y here.

config SERIAL_CORE
	tristate

config SERIAL_CORE_CONSOLE
	bool

config CONSOLE_POLL
	bool

endmenu
```

## sdk/linux-2.6.x/drivers/usb/dwc_otg/Kconfig
```kconfig
config DWC_OTG
        tristate "Synopsys DWC_OTG support"
        ---help---
          This driver supports Synopsys DWC_OTG 

config DWC_OTG_DEBUG
        bool "enable debug mode"
        depends on DWC_OTG


config DWC_OTG_HOST_ONLY
        bool "HOST ONLY MODE"
        depends on DWC_OTG

config DWC_OTG_DEVICE_ONLY
        bool "DEVICE ONLY MODE"
        depends on DWC_OTG
```
