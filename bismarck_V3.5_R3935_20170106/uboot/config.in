## sdk/linux-2.6.x/arch/rlx/bsp_rtl8196c/config.in
```kconfig
config RTL_819X
	def_bool y

config RTL_8196C
	def_bool y

#
# Processor Config
#
config ARCH_32BIT
  bool 
  default y

config ARCH_CPU_RLX4181
  bool 
  default y

config ARCH_CPU_EB
  bool 
  default y

config ARCH_CPU_EL
  bool 
  default n

config ARCH_CPU_RADIAX
  bool 
  default n

config ARCH_CPU_SLEEP
  bool
  default y

config ARCH_CPU_ULS
  bool 
  default n

config ARCH_CPU_LLSC
  bool 
  default n

config ARCH_CPU_SYNC
  bool
  default n

config ARCH_CACHE_WB
  bool 
  default y

config ARCH_CACHE_L2
  bool 
  default n

config ARCH_IRQ_CPU
  bool 
  default y

config ARCH_IRQ_VEC
  bool 
  default y

config ARCH_BUS_USB
  bool 
  default n

config ARCH_BUS_PCI
  bool 
  default y

config ARCH_BUS_PCI_MSI
  bool
  default n

#
# System Config
#
menu "System Configuration"
choice
	prompt "System Type"
	default RTL_8196C_GW

config RTL_8196C_GW
        bool "RTL8196C Demo Board"
        help
          This enables support for Realtek RTL8196C demo board

config RTL_8196C_ICT
        bool "RTL8196C IC Test"
        #select FPGA_PLATFORM
          
endchoice

config RTL8196C_REVISION_B
	bool
	default y if RTL_8196C_GW

config RTL8196C_GREEN_ETHERNET
	bool
	default y if RTL_8196C_GW

config FPGA_PLATFORM
	bool

config RTL_PCIE_SIMPLE_INIT
	bool
	default y if RTL8192SE
	default y if RTL8192CD

config RTL_WTDOG
	bool "Enable watchdog timer support"

config RTL_TIMER_ADJUSTMENT
	bool "Enable timer adjustment support"
	
config RTL_WEBPAGES_IN_ROOTFS
	bool "Webpages in rootfs support"
 
config RTL819X_SPI_FLASH
	bool "SPI flash support"

config RTL_FLASH_MAPPING_ENABLE
	bool "Enable Flash Mapping"

comment "Flash size 2M or 4M, default 2M"
	depends on RTL_FLASH_MAPPING_ENABLE
config RTL_FLASH_SIZE
	hex "Size of Flash"
	depends on RTL_819X && RTL_FLASH_MAPPING_ENABLE
	default "0x200000"
	help
          Size of Flash, Normally should be 2M or 4M.

comment "Hardware setting offset,should be 4K alignment"
	depends on RTL_FLASH_MAPPING_ENABLE
config RTL_HW_SETTING_OFFSET
        hex "Hardware setting offset in flash."
        depends on RTL_819X && RTL_FLASH_MAPPING_ENABLE
        default "0x6000"
        help
	  Hardware Setting store in flash from the offset.
	  it should be 4k alignment.

comment "Default setting offset,should be 4K alignment."
	depends on RTL_FLASH_MAPPING_ENABLE
comment "size of default and current setting should be same."
	depends on RTL_FLASH_MAPPING_ENABLE
config RTL_DEFAULT_SETTING_OFFSET
        hex "Default setting offset in flash."
        depends on RTL_819X && RTL_FLASH_MAPPING_ENABLE
        default "0x8000"
        help
	  Default Setting store in flash from the offset.
	  normally the default setting shoud save before current settting.
	  NOTE: make sure it's size is enough for default setting,
		default size is 16K.

comment "Current setting offset,should be 4K alignment."
	depends on RTL_FLASH_MAPPING_ENABLE
config RTL_CURRENT_SETTING_OFFSET
        hex "Current setting offset in flash."
        depends on RTL_819X  && RTL_FLASH_MAPPING_ENABLE
        default "0xC000"
        help
	  Current Setting store in flash from the offset.
	  normally the current setting saved after default setting.
	  NOTE: make sure it's size is enough for current setting,
		default size is 16K.

comment "Webpage image offset,should be 4K alignment."
	depends on RTL_FLASH_MAPPING_ENABLE
comment "size of web page is normally about 100K."
	depends on RTL_FLASH_MAPPING_ENABLE
config RTL_WEB_PAGES_OFFSET
	hex "webpages image offset in flash."
	depends on RTL_819X && RTL_FLASH_MAPPING_ENABLE
	default "0x10000"
	help
	  Webpages image store in flash from the offset.
	  NOTE: default size is 128K.

comment "Linux image offset,should be 4K alignment."
	depends on RTL_FLASH_MAPPING_ENABLE
comment "this offset MUST between 0x10000~0x40000."
	depends on RTL_FLASH_MAPPING_ENABLE
config RTL_LINUX_IMAGE_OFFSET
        hex "linux image offset in flash."
        depends on RTL_819X  && RTL_FLASH_MAPPING_ENABLE
        default "0x30000"
        help
	  linux image store in flash from the offset.

comment "Root image offset,should be 64K alignment."
	depends on RTL_FLASH_MAPPING_ENABLE
config RTL_ROOT_IMAGE_OFFSET
        hex "root image offset in flash."
        depends on RTL_819X  && RTL_FLASH_MAPPING_ENABLE
        default "0xF0000"
        help
	  root image store in flash from the offset.

# KERNE_STACK_SIZE = PAGE_SIZE<<KERNEL_STACK_SIZE_ORDER
config KERNEL_STACK_SIZE_ORDER
	int "Kenel Stack Size Order Configuration"
	default "2"
	help
	  With Page Size 4K
	  1 for 8K kenel stack size
	  2 for 16K kernel stack size
	  3 for 32K kernel stack size
	  etc...
endmenu

# remove this line when make SDK
#source "../target/Kconfig.ictest"
```

## sdk/linux-2.6.x/arch/rlx/bsp_rtl8681/config.in
```kconfig
#config RTL_819X
#	def_bool y

#config RTL_8196C
#	def_bool y

#
# Processor Config
#
config ARCH_32BIT
  bool 
  default y

config ARCH_CPU_RLX5181
  bool 
  depends on !RLE0437
  default y
  
#config ARCH_CPU_RLX5281
#  bool 
#  default n

config ARCH_CPU_RLX4181
  bool
  default n

config ARCH_CPU_EB
  bool 
  default y

config ARCH_CPU_EL
  bool 
  default n

config ARCH_CPU_RADIAX
  bool 
  default n

config ARCH_CPU_SLEEP
  bool
  default n

config ARCH_CPU_ULS
  bool 
  default y

config ARCH_CPU_LLSC
  bool 
  default n

config ARCH_CPU_SYNC
  bool
  default n

config ARCH_CACHE_WBC
  bool 
  default y

config ARCH_CACHE_L2
  bool 
  default n

config ARCH_IRQ_CPU
  bool 
  default y

config ARCH_IRQ_VEC
  bool 
  default y

config ARCH_BUS_USB
  bool 
  default n

config ARCH_BUS_PCI
  bool 
  default y

config ARCH_BUS_PCI_MSI
  bool
  default n

#
# System Config
#
menu "System Configuration"
choice
	prompt "System Type"
	default RTL8672

config RTL8672
	bool "Realtek RTL8672 board"
	select CPU_BIG_ENDIAN
	help
	  This enables supports for RTL8672-based boards          
endchoice

config RLE0412
	bool "Support for RLE0412"
	select ARCH_CPU_RLX5281
	select ARCH_CPU_SYNC
	default n

config RLE0437
	bool "Support for RLE0437"
	select ARCH_CPU_RLX4181
	default n

# KERNE_STACK_SIZE = PAGE_SIZE<<KERNEL_STACK_SIZE_ORDER
config KERNEL_STACK_SIZE_ORDER
	int "Kenel Stack Size Order Configuration"
	default "2"
	help
	  With Page Size 4K
	  1 for 8K kenel stack size
	  2 for 16K kernel stack size
	  3 for 32K kernel stack size
	  etc...



choice
	prompt "Flash Size"
	depends on RTL8672
	default 4M_FLASH

config 2M_FLASH
	bool "2M"

config 4M_FLASH
	bool "4M"

config	8M_FLASH
	bool "8M"

config	16M_FLASH
	bool "16M"
endchoice



config SPANSION_16M_FLASH
	bool "Support for SPANSION 16M FLASH"
	depends on RTL8672



config 64KB_CONF_PART
	bool "Support a 64KB config partition for TR-069"
	depends on RTL8672 



config EOC
	bool "Support for DSL EOC channel"
	depends on RTL8672 

config E8B
	bool "Support for CTC E8B requirement"

config NEW_PORTMAPPING
    bool "Support the new port mapping"
    depends on E8B

choice	
	prompt "IMEM Size"
	depends on RTL8672
	default	IMEM_4K

config	IMEM_4K
	bool "4K"

config	IMEM_32K
	bool "32K"

config	IMEM_64K
	bool "64K"

endchoice

choice	
	prompt "IMEM1 Size"
	depends on ARCH_CPU_RLX5281
	default	IMEM1_32K

config	IMEM1_4K
	bool "4K"

config	IMEM1_32K
	bool "32K"

config	IMEM1_64K
	bool "64K"

endchoice

config IMEM_SIZE
	hex
	default "10000" if IMEM_64K
	default "8000" if IMEM_32K
	default "1000"
	
config IMEM1_SIZE
	hex
	default "10000" if IMEM1_64K
	default "8000" if IMEM1_32K
	default "1000"

choice
	prompt "LED Style"
	depends on RTL8672 
	default GPIO_LED_TR068
	
config GPIO_LED_TR068
	bool "TR068"
endchoice

config RTL8672_SW_USB_LED
	tristate "Support Software USB LED"
	depends on USB_RTL8672_SUPPORT

config SW_USB_LED0
	bool "Software USB LED 0"
	depends on RTL8672_SW_USB_LED

config SW_USB_LED1
        bool "Software USB LED 1"
        depends on RTL8672_SW_USB_LED

config	WPS_LED
	 bool "Support WPS LED"
	depends on WIFI_SIMPLE_CONFIG
        depends on RTL8672

choice
	prompt "Hardware Board"
	depends on RTL8672 
	default BOARD_000
	
config BOARD_000
	bool "Board000 - default"

config BOARD_001
	bool "Board001 - combo - 1P"
	
config BOARD_002
	bool "Board002 - E8B - 4P Wifi"

config BOARD_003
	bool "Board003 - 4P Wifi"

config BOARD_003v6
        bool "Board003v6 - 4P Wifi"

config BOARD_004
	bool "Board004 - BGA 356 IAD board"

config BOARD_005
        bool "Board005 - RLE0315 4P Wifi"

config BOARD_006
        bool "Board006 - RTL8672 RL6166 IAD"

config BOARD_007
        bool "Board007 - RTL8676 4P Wifi"

config BOARD_008
        bool "Board008 - RTL8676 IAD"
endchoice

choice
	prompt "UART selection"
	depends on RTL8672
	default USE_UART1 if (BOARD_006 || RLE0412)
	default USE_UART0

config USE_UART0
	bool "Use UART0"

config USE_UART1
	bool "Use UART1"
endchoice

config MEM_LIMITATION
        bool "Memory size limitation"
        default n
endmenu
```

## sdk/linux-2.6.x/arch/rlx/bsp_rtl8686/Kconfig
```kconfig
#
# Realtek Semiconductor Corp.
#
# Luna Platform Kernel Configuration
#
# Bo-Hung Wu (bohungwu@realtek.com)
# Apr. 01, 2014
#


menu "Luna Platform Configuration"

config LUNA_CMU
	depends on !ARCH_LUNA_SLAVE
	bool "Luna platform clock mangement module"
	default n
	help 
		Enable/Disable clock management dynamic mode by Kernel.
		When this moduel is built, clock management dynamic mode
		will be turned off at the entry of RLX trap handler and
		turned on at the entry of cpu_idle().
		
config CPU0_FREQ_DIV_INDEX
	int "CPU0 frequency dividing factor at dynamic mode on (1:(1/2)F, 2:(1/4)..)"
	depends on LUNA_CMU
	range 1 7
	default 1
	help
		1:(1/2)F, 2:(1/4), 3:(1/8), 4:(1/16), 5:(1/32), 6:(1/64), 7:(1/128)

config CPU0_DLY_SLP_INDEX
	int "CPU0 frequency dividing activation delay (0: 0.5us, 1:1us, ...)"
	depends on LUNA_CMU
	range 0 7
	default 0
	help
		0:0.5us, 1:1us, 2:2us, 3:4us, 4:8us, 5:16us, 6:32us, 7:No Sleep

config LUNA_WDT
	depends on !ARCH_LUNA_SLAVE
	bool "Luna platform watchdog"
	default n
	help 
		Control (enable/disable) watchdog.
		Configure time-out and etc setting for watchdog

config LUNA_WDT_KTHREAD
	depends on !ARCH_LUNA_SLAVE && LUNA_WDT
	bool "Luna platform watchdog with watchdog kthread for kick"
	default n
	help 
		Control (enable/disable) watchdog.
		Configure time-out and etc setting for watchdog

config WDT_ENABLE
	int "Enable or disalble WDT at boot-up"
	depends on LUNA_WDT_KTHREAD
	range 0 1
	default 1
	help
		0:disable, 1:enable

config WDT_CLK_SC
	int "WDT overflow scale"
	depends on LUNA_WDT_KTHREAD
	range 0 3
	default 3
	help
		0:2^25, 1:2^26, 2:2^27, 3:2^28

config WDT_PH1_TO
	int "WDT phase 1 time-out threshold"
	depends on LUNA_WDT_KTHREAD
	range 0 31
	default 31


config WDT_PH2_TO
	int "WDT phase 2 time-out threshold"
	depends on LUNA_WDT_KTHREAD
	range 0 31
	default 0
	help
		In the WDT ISR, related system information for further debugging should be collected within PH2.

config WDT_RESET_MODE
	int "WDT reset mode after PH2 time-out expires."
	depends on LUNA_WDT_KTHREAD
	range 0 2
	default 0
	help
		0:H/W Full Chip Reset, 
		1:H/W CPU & IPSec Reset 
		2:S/W Reset

config LUNA_USE_SRAM
	bool "Luna platform 32KB SRAM mapping"
	depends on !ARCH_LUNA_SLAVE
	default n
	help 
		Enable/Disable the 32KB SRAM Mapping automatically.
		The function will map 32KB space for __sram address of vmlinux.lds from DRAM onto SRAM
		to improve the performance.

config LUNA_USE_SRAM_ADDR
	hex "Luna platform 32KB SRAM mapping address(0 => Address of __sram section)"
	depends on LUNA_USE_SRAM
	default 0x0
	help 
		The start address of sram mapping. 0x0 indicates that the platform will map the __section section
		from DRAM to SRAM with 32KB memory space. The assigned address would be used instead of __sram address.


config LUNA_PROC_CP3_MONITOR
         bool "Luna Performance Profiling" if !RTK_CP3_PERF
	 default n
	---help---
		Enable system profile tool /proc/cp3monitor.
		Support CP0 CYCLE register and 4 CP3 event counters probe. 

							     
config LUNA_PROC_CP3_MONITOR_EXCLUDE_IDLE
	bool "Luna Performance Profiling Exclude from Idle Thread"
	depends on LUNA_PROC_CP3_MONITOR
	---help---
		Support '-idle <cycle count>' option for system profile tool /proc/cp3monitor.
		System will wait <cycle count> cycles and stop counting CP3 event counters when in cpu_idle thread.

config LUNA_CPU_OPTION_SWITCH
	bool "Luna platform support CPU options switch"
	default n
	help 
		For experiment goal, allow user to disable or enable CPU options.


config LUNA_RESERVE_DRAM_FOR_PBO
	bool "Luna platform reserve DRAM for PBO"
	depends on !ARCH_LUNA_SLAVE
	default n
	help 
		Enable/Disable DRAM reservation for PBO

config LUNA_PBO_DL_DRAM_OFFSET
	hex "Luna platform PBO DL DRAM OFFSET"
	depends on LUNA_RESERVE_DRAM_FOR_PBO
	default 0x1700000
	help 
		The offset of DRAM to be reserved for PBO DL.

config LUNA_PBO_DL_DRAM_SIZE
	hex "Luna platform PBO DL DRAM SIZE"
	depends on LUNA_RESERVE_DRAM_FOR_PBO
	default 0x100000
	help 
		The size of DRAM to be reserved for PBO DL.

config LUNA_PBO_UL_DRAM_OFFSET
	hex "Luna platform PBO UL DRAM OFFSET"
	depends on LUNA_RESERVE_DRAM_FOR_PBO
	default 0x1F00000
	help 
		The offset of DRAM to be reserved for PBO UL.

config LUNA_PBO_UL_DRAM_SIZE
	hex "Luna platform PBO UL DRAM SIZE"
	depends on LUNA_RESERVE_DRAM_FOR_PBO
	default 0x100000
	help 
		The size of DRAM to be reserved for PBO UL.

config LUNA_SOC_GPIO
	depends on !ARCH_LUNA_SLAVE
	bool "Luna SOC GPIO"
	default n
	help 
		Enable/Disable the use SOC GPIO (disable uses switch GPIO).

endmenu
```
