## sdk/linux-2.6.x/drivers/net/rtl819x/Kconfig
```kconfig
menuconfig RTL_819X_SWCORE
	bool "Options for Realtek SoC"
        depends on NET && (RTL_819X || RTL_8676HWNAT)
	default y
        ---help---
          You can say N here if you don't intend to use Realtek 819X SoC at all.

          You'll have to say Y if only 819X Soc is used for your router.

          If unsure, say Y.

#config RTL865XC
#	bool
#	default y

if RTL_819X_SWCORE

config RTL_8196C
	bool
	default y

config RTL8196C_REVISION_B
	bool
	default y

config RTL_8196D
	bool
	default y

config DEFAULTS_KERNEL_2_6
	bool
	default y
	
config NEW_PCI
	bool 
	default y 
	depends on PCI

config RTL8196E_IPCHECKSUM_ERROR_PATCH
        bool
        default y

#config RTL_IGMP_PROXY
#	bool
#	default y
#	depends on !RTL_HW_PURE_SWITCH

#config RTL_IGMP_SNOOPING
#	bool "RTL_IGMP_SNOOPING"
#	default y
#	depends on !RTL_HW_PURE_SWITCH

#config RTL_MLD_SNOOPING
#	bool 
#	default y
#	depends on RTL_IGMP_SNOOPING

config RTL_LINKCHG_PROCESS
	bool
	default y
	depends on !RTL_HW_PURE_SWITCH

menu "Config MIPS16-Inst Option for Kernel Modules"
	config RTL865X_KERNEL_MIPS16
		bool "Enable MIPS16 Encoding for Linux Kernel"
		default n
		depends on RTL_819X || RTL_8676HWNAT
	comment "Config Optional MIPS16-Inst Option for Kernel Modules"
	config RTL865X_KERNEL_MIPS16_CRYPTO
		bool "Enable MIPS16 Encoding for crypto module(linux-2.x.x/crypto)"
		default n
		depends on RTL865X_KERNEL_MIPS16
	config RTL865X_KERNEL_MIPS16_FS
		bool "Enable MIPS16 Encoding for fs     module(linux-2.x.x/fs)"
		default n
		depends on RTL865X_KERNEL_MIPS16
	config RTL865X_KERNEL_MIPS16_IPC
		bool "Enable MIPS16 Encoding for ipc    module(linux-2.x.x/ipc)"	
		default n
		depends on RTL865X_KERNEL_MIPS16
	config RTL865X_KERNEL_MIPS16_KERNEL
		bool "Enable MIPS16 Encoding for core   module(linux-2.x.x/kernel)"
		default n
		depends on RTL865X_KERNEL_MIPS16
	config RTL865X_KERNEL_MIPS16_LIB
		bool "Enable MIPS16 Encoding for lib    module(linux-2.x.x/lib)"
		default n
		depends on RTL865X_KERNEL_MIPS16
	config RTL865X_KERNEL_MIPS16_MM
		bool "Enable MIPS16 Encoding for mm     module(linux-2.x.x/mm)"
		default n
		depends on RTL865X_KERNEL_MIPS16
	config RTL865X_KERNEL_MIPS16_NET
		bool "Enable MIPS16 Encoding for net    module(linux-2.x.x/net)"
		default n
		depends on RTL865X_KERNEL_MIPS16
	comment "Config Optional MIPS16-Inst Option for Device Drivers"
	config RTL865X_KERNEL_MIPS16_MTD
		bool "Enable MIPS16 Encoding for mtd    module(linux-2.x.x/drivers/mtd)"
		default n
		depends on RTL865X_KERNEL_MIPS16
	config RTL865X_KERNEL_MIPS16_LAYERDRIVER
		bool "Enable MIPS16 Encoding for lan    module(linux-2.x.x/drivers/net/re865x)"
		default n
		depends on RTL865X_KERNEL_MIPS16
	config RTL865X_KERNEL_MIPS16_WLAN
		bool "Enable MIPS16 Encoding for wlan   module(linux-2.x.x/drivers/net/wirless/rtl8190)"
		default n
		depends on RTL865X_KERNEL_MIPS16
	config RTL865X_KERNEL_MIPS16_PCI
		bool "Enable MIPS16 Encoding for pci    module(linux-2.x.x/drivers/pci)"
		default n
		depends on RTL865X_KERNEL_MIPS16
	config RTL865X_KERNEL_MIPS16_CHAR
		bool "Enable MIPS16 Encoding for char   module(linux-2.x.x/drivers/char)"
		default n
		depends on RTL865X_KERNEL_MIPS16
	config RTL865X_KERNEL_MIPS16_BLOCK
		bool "Enable MIPS16 Encoding for block  module(linux-2.x.x/drivers/block)"
		default n
		depends on RTL865X_KERNEL_MIPS16
endmenu

menu "Config for Layered Driver Features"
	config RTL_LAYERED_DRIVER
        	bool
	        default y
        	depends on RTL_819X || RTL_8676HWNAT

	config RTL_LAYERED_ASIC_DRIVER
                bool
                default n
                depends on RTL_LAYERED_DRIVER
	
	config RTL_LAYERED_ASIC_DRIVER_L3
                bool
                default n
                depends on RTL_LAYERED_ASIC_DRIVER

	config RTL_LAYERED_ASIC_DRIVER_L4
                bool
                default n
                depends on RTL_LAYERED_ASIC_DRIVER

	config RTL_LAYERED_DRIVER_ACL
		bool
		default n
		depends on RTL_LAYERED_DRIVER

	config RTL_LAYERED_DRIVER_L2
		bool
		default n
		depends on RTL_LAYERED_DRIVER

	config RTL_HW_QOS_SUPPORT
		bool
                default n
                depends on RTL_LAYERED_DRIVER

	config RTL_LAYERED_DRIVER_L3
		bool
                default n
                depends on RTL_LAYERED_DRIVER


	config RTL_LAYERED_DRIVER_L4
		bool
                default n
                depends on RTL_LAYERED_DRIVER
	
	comment 'Choose basic features.'

        config RTL_LINKCHG_PROCESS
		bool
                default n 
                depends on RTL_LAYERED_DRIVER

        config RTL_EXTPORT_VLANID
       	        int
               	default "9"
                depends on RTL_LAYERED_DRIVER

	comment 'Choose hardware features.'	
	
	choice  
       		prompt "Hardware Features Selection"
        	default RTL_HW_MULTICAST_ONLY
		depends on RTL_LAYERED_DRIVER

	config RTL_HW_NAPT
		bool "Enable RTL Hardware NAPT"
#		depends on RTL_8198
		select RTL_LAYERED_ASIC_DRIVER
		select RTL_LAYERED_ASIC_DRIVER_L3
		select RTL_LAYERED_ASIC_DRIVER_L4
		select RTL_LAYERED_DRIVER_ACL
		#select RTL_HW_QOS_SUPPORT
		select RTL_LAYERED_DRIVER_L2
                select RTL_LAYERED_DRIVER_L3
                select RTL_LAYERED_DRIVER_L4
                select RTL_HARDWARE_MULTICAST
		select RTL_HARDWARE_NAT
	
	config RTL_HW_MULTICAST_ONLY
		bool "Enable RTL Hardware Multicast Only"
		select RTL_LAYERED_ASIC_DRIVER
		select RTL_LAYERED_ASIC_DRIVER_L3
		select RTL_LAYERED_DRIVER_ACL
		select RTL_LAYERED_DRIVER_L2
                select RTL_LAYERED_DRIVER_L3
		select RTL_HARDWARE_MULTICAST

	config RTL_HW_L2_ONLY
		bool "Enable RTL Hardware switch Only"
		select RTL_LAYERED_ASIC_DRIVER		
		select RTL_LAYERED_DRIVER_ACL		#because mld snooping need add acl to trap ipv6 multicast packet to cpu
		select RTL_LAYERED_DRIVER_L2

	config RTL_HW_PURE_SWITCH
		bool "Enable RTL Hardware pure switch"
		select RTL_LAYERED_ASIC_DRIVER		
		---help---
		When using this config, the RTL8676 swcore will become a nic with simple switch. We only 
		access netif table, vlan table and acl table. This config doesn't include L2 DRIVER and rtl865x_eventMgr
		, and deselect RTL_IGMP_SNOOPING, RTL_IGMP_PROXY, RTL_MLD_SNOOPING and RTL_LINKCHG_PROCESS.
	
	endchoice
	        
	comment 'Choose advance features.'	

	config RTL_NETIF_MAPPING
                bool "enable linux ps vs rtl819x driver netif mapping"
                default y
                depends on RTL_LAYERED_DRIVER

	config RTL865X_LANPORT_RESTRICTION
                bool "Rtl865x lan port restriction"
                default n
                depends on RTL_LAYERED_DRIVER

	config RTL_QOS_8021P_SUPPORT
		bool "HW Qos support vlan priority"
                default n
                depends on RTL_HW_QOS_SUPPORT

	config RTL_IVL_SUPPORT
		bool "Support multi-vlan in bridge/wisp mode"
                default n
                depends on RTL_LAYERED_DRIVER
	config RTL_LOCAL_PUBLIC
		bool "Enable RTL local public"
		default n
		depends on RTL_HW_NAPT
endmenu
	
#config RTK_KERNEL_MIPS16
#        bool "Encode Kernel Code with MIPS16 Instruction Set"
#        default y
#        depends on RTL_819X


choice
	prompt "ACL Type Selection"
	default RTL8676_Dynamic_ACL
	depends on RTL_HW_NAPT
		
	config RTL8676_Static_ACL
		bool "0412 Static ACL"
		depends on RTL_HW_NAPT

	config RTL8676_Dynamic_ACL
		bool "0412 Dynamic ACL"
		depends on RTL_HW_NAPT
		---help---
		Enable dynamic ACL can keep the functionality of IP/Port filter when hardware forwarding in MER mode without NAPT (pure L3 routing)
		If you do not care this functionality, you can use static ACL  to decrease the number of AISC ACL entries using.
endchoice

config RTL_IPTABLES_FILTER_RULE_2_ACL
	bool "Convert iptables filter table to 8676 ACL(For Firewall)"
        default y
        depends on RTL_HW_NAPT && RTL8676_Static_ACL

config RTL_IPTABLES_MANGLE_RULE_2_ACL
        bool "Convert iptables mangle table to 8676 ACL(For IPQos)"
        default y
        depends on RTL_HW_NAPT		

config RTL865X_MBUF_HEADROOM
	int
	range 0 256
	default "128"
	depends on RTL_819X || RTL_8676HWNAT

config RTL_ETH_PRIV_SKB
	bool "Enable Ethernet Private Skb"
	default n
	depends on RTL_819X || RTL_8676HWNAT

config RTL_ETH_PRIV_SKB_DEBUG
	bool 
	default n
	depends on RTL_ETH_PRIV_SKB

#config RTL8190_PRIV_SKB
#	bool "Enable 8190 Private Skb"
#	default y
#	depends on RTL_819X
	
#config RTL8214_SUPPORT
#	bool
#	default n
#	depends on RTL_819X
	
config EXTRTL8212_PHYID_P1
	int
	default "18"
	depends on RTL_819X || RTL_8676HWNAT

config EXTRTL8212_PHYID_P3
	int
	default "20"
	depends on RTL_819X || RTL_8676HWNAT

config EXTRTL8212_PHYID_P5
	int
	default "22"
	depends on RTL_819X || RTL_8676HWNAT


#config RTL865X_EXTPORT
#	bool "Rtl865x extension port"
#	default n
#	depends on RTL865X_LAYERED_DRIVER

#config RTL865X_EXTPORT_VLANID
#	int
#	default "9"
#	depends on RTL865X_EXTPORT

config RTL_HW_QOS_SUPPORT
	bool "Support HW Qos"
	default n
	depends on RTL_LAYERED_DRIVER
	depends on RTL_HARDWARE_NAT

config RTL_HARDWARE_MULTICAST
	bool
	default n
	depends on RTL_LAYERED_DRIVER
	depends on RTL_IGMP_SNOOPING

config RTL_HARDWARE_NAT
	bool
	default n
	depends on RTL_819X || RTL_8676HWNAT
	select HWNAT

#config RTL865x_TCPFLOW_NONE_STATUS_CHECK
#	bool "Create HW NAT Entry without checking tcp flow status (For SMB/IXIA tcp test)"
#	default n
#	depends on RTL865X_HARDWARE_NAT

config RTL_PPPOE_HWACC
	bool
	default y
	depends on RTL_HARDWARE_NAT

config RTL865X_HW_PPTPL2TP
	bool
	default n
	depends on RTL_HARDWARE_NAT

config RTL_PROC_DEBUG
	bool "Enable proc filesystem for debug"
	default n
	depends on RTL_819X || RTL_8676HWNAT

config RTL865X_ROMEPERF
	bool "Enable rome perf"
	default n
	depends on RTL_819X || RTL_8676HWNAT

config RTK_VLAN_SUPPORT
	bool "Support VLAN feature"
	default y
	depends on RTL_819X || RTL_8676HWNAT

config RTK_VLAN_FOR_CABLE_MODEM
	bool "VLAN for cable modem"
	default n
	depends on RTK_VLAN_SUPPORT

config HARDWARE_NAT_DEBUG
	bool "Hardware NAT debug"
	default y
	depends on RTL_8676HWNAT

#config NMS
#	bool "Enable NMS"
#	default n
#	depends on MESH_ENABLE

#config TEST_PKG
#	bool "Test Package(test_traffic ...)" 
#	default n
#	depends on MESH_ENABLE

#config 11S_TEST_MODE
#	bool "Enable 11s Test Mode"
#	default n
#	depends on MESH_ENABLE
	
config RTL_UNKOWN_UNICAST_CONTROL
	bool
	default n
	depends on RTL_819X || RTL_8676HWNAT

config RTL_ENABLE_RATELIMIT_TABLE
	bool
	default y
	depends on RTL_UNKOWN_UNICAST_CONTROL

#config RTL_MULTI_LAN_DEV
#	bool "multi lan device"
#	default y
#	depends on (RTL_819X || RTL_8676HWNAT)

#config RTL_MULTI_ETH_WAN
#	bool "Multi WAN support"
#	default y
#	depends on ETHWAN

config PORT_MIRROR
	bool "smux port mirror"
	default n
	depends on RTL_MULTI_ETH_WAN

config RTL_NIC_HWSTATS
	bool "Synchronize hardware statistics into net_stats"
	default n
	depends on RTL_819X || RTL_8676HWNAT

endif #RTL_819X_SWCORE
#endmenu
#============================= End of Kconfig ===============================#

	 
```

## sdk/linux-2.6.x/drivers/net/rtl86900/Kconfig
```kconfig
#
#pollo RomeDriver configuration
#

if RTK_L34_ENABLE
source "drivers/net/rtl86900/romeDriver/Kconfig"
endif #RTK_L34_ENABLE
```
