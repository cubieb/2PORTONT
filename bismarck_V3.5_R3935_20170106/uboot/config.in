## bismarck_V3.5_R3935_20170106/uboot/config.in
```kconfig
mainmenu_name "U-Boot Configuration"

mainmenu_option next_comment
comment 'Board'

define_bool CONFIG_RTL838XS n
define_bool CONFIG_RTL839XS n
define_int  CONFIG_EXCEPTION_BASE CONFIG_SYS_TEXT_BASE
choice 'Realtek' "RTL838x    CONFIG_RTL838X
                  RTL839x    CONFIG_RTL839X
                  LUNA       CONFIG_LUNA
                  RTL9601B   CONFIG_RTL9601B
                  RTL9601C   CONFIG_RTL9601C
                  RTL9602C   CONFIG_RTL9602C
                  G.FAST     CONFIG_GFAST
                  RTL8685S   CONFIG_RTL8685S
                  RTL9300    CONFIG_RTL9300"

if [ "$CONFIG_LUNA" = "y" ]; then
	choice 'Console' "UART0 CONFIG_UART0
	                  UART1 CONFIG_UART1" UART0
fi

comment 'U-Boot Location'
hex 'U-Boot Text Base' CONFIG_SYS_TEXT_BASE  	0x80F00000

endmenu

if [ "$CONFIG_RTL838X" = "y" ] || [ "$CONFIG_RTL838XS" = "y" ]; then
	source ./board/Realtek/rtl838x/menuconfig.in
elif [ "$CONFIG_RTL839X" = "y" ] || [ "$CONFIG_RTL839XS" = "y" ]; then
	source ./board/Realtek/rtl839x/menuconfig.in
elif [ "$CONFIG_LUNA" = "y" ] || [ "$CONFIG_LUNAS" = "y" ]; then
	source ./board/Realtek/luna/menuconfig.in
elif [ "$CONFIG_RTL9601B" = "y" ]; then
	source ./board/Realtek/rtl9601b/menuconfig.in
elif [ "$CONFIG_RTL9601C" = "y" ]; then
	source ./board/Realtek/rtl9601C/menuconfig.in
elif [ "$CONFIG_RTL9602C" = "y" ]; then
	source ./board/Realtek/rtl9602C/menuconfig.in
elif [ "$CONFIG_RTL8685S" = "y" ]; then
	source ./board/Realtek/rtl8685s/menuconfig.in
elif [ "$CONFIG_GFAST" = "y" ]; then
	source ./board/Realtek/gfast/menuconfig.in
elif [ "$CONFIG_RTL9300" = "y" ]; then
	source ./board/Realtek/rtl9300/menuconfig.in
fi

if [ "$CONFIG_SPI_NOR_FLASH" = "y" ]; then
	source ./arch/otto/lib/nor_spif_vendors.in
fi
```

## sdk/config.in
```kconfig
mainmenu_name 'uClinux Configuration'
mainmenu_option next_comment
comment 'Target Platform Selection'
comment 'Choose a Vendor/Product combination.'
choice 'Vendor/Product' "Realtek/luna CONFIG_DEFAULTS_REALTEK_LUNA \
" SecureEdge/SecureEdgeVPN
	bool 'Dual Linux' CONFIG_LUNA_DUAL_LINUX
comment 'Kernel is linux-2.6.x'
define_bool CONFIG_DEFAULTS_KERNEL_2_6 y
if [ "$CONFIG_DEFAULTS_KERNEL_2_6" = "y" ]; then
	choice 'LINUX Kernel 2.6 Version'	"2.6.19         CONFIG_KERNEL_2_6_19
						 2.6.30         CONFIG_KERNEL_2_6_30
						"2.6.19
fi
	bool 'Use RSDK-Wrapper Toolchain'	CONFIG_USE_RSDK_WRAPPER
	if [ "$CONFIG_LUNA_DUAL_LINUX" = "y" ]; then
		string 'RSDK Toolchain Path for Master' CONFIG_RSDK_DIR_MASTER
		string 'RSDK Toolchain Path for Slave'  CONFIG_RSDK_DIR_SLAVE
	else
		string 'RSDK Toolchain Path'	CONFIG_RSDK_DIR
	fi
bool 'Customize Kernel Settings' CONFIG_DEFAULTS_KERNEL
bool 'Customize Vendor/User Settings' CONFIG_DEFAULTS_VENDOR
#Added by Mason Yu. for ipv6
bool 'Config Busybox Settings'     CONFIG_MCONF_BZBOX
if [ "$CONFIG_LUNA_DUAL_LINUX" = "y" ]; then
	bool 'Customize Slave Kernel Settings'        CONFIG_DEFAULTS_SLAVE_KERNEL
	bool 'Customize Slave Vendor/User Settings'   CONFIG_DEFAULTS_SLAVE_VENDOR
	bool 'Customize Slave Busybox Setting' CONFIG_MCONF_SLAVE_BZBOX
fi
bool 'Tiny Image'                CONFIG_IMAGE_TINY
bool 'VoIP IPC DSP Architecture' CONFIG_VOIP_IPC_DSP_ARCHITECTURE
choice 'Otto Prelaoder Version'	"None        CONFIG_PLR_NONE
				 1.X         CONFIG_USE_PRELOADER_PARAMETERS
				 3.X         CONFIG_PLR_3X
				"None
if [ "$CONFIG_USE_PRELOADER_PARAMETERS" = "y" ]; then
	define_bool CONFIG_PLR_1X y
fi
bool 'Luna trunk only'           CONFIG_LUNA
if [ "$CONFIG_LUNA_DUAL_LINUX" != "y" ]; then
bool 'Luna memory auto distribution' CONFIG_LUNA_MEMORY_AUTO_DETECTION
else
define_bool CONFIG_LUNA_MEMORY_AUTO_DETECTION n
fi

if [ "$CONFIG_LUNA_MEMORY_AUTO_DETECTION" = "y" ] && [ "$CONFIG_VOIP_IPC_DSP_ARCHITECTURE" = "y" ]; then
#	hex  "RTL8686 CPU MEM Size" CONFIG_RTL8686_CPU_MEM_SIZE 0x03800000
	hex  "RTL8686 IPC MEM Size" CONFIG_RTL8686_IPC_MEM_SIZE 0x00100000
	hex  "RTL8686 DSP MEM Size" CONFIG_RTL8686_DSP_MEM_SIZE 0x00700000
fi
if [ "$CONFIG_LUNA_MEMORY_AUTO_DETECTION" != "y" ] && [ "$CONFIG_VOIP_IPC_DSP_ARCHITECTURE" = "y" ]; then
	comment "RTL8686 IPC Shared Memory Setting"
	if [ "$CONFIG_LUNA_DUAL_LINUX" = "y" ]; then
        hex  "RTL8686 CPU MEM Base" CONFIG_RTL8686_CPU_MEM_BASE 0x00000000
        hex  "RTL8686 CPU MEM Size" CONFIG_RTL8686_CPU_MEM_SIZE 0x02800000
        hex  "RTL8686 IPC MEM Base" CONFIG_RTL8686_IPC_MEM_BASE 0x02800000
        hex  "RTL8686 IPC MEM Size" CONFIG_RTL8686_IPC_MEM_SIZE 0x00100000
        hex  "RTL8686 DSP MEM Base" CONFIG_RTL8686_DSP_MEM_BASE 0x02900000
        hex  "RTL8686 DSP MEM Size" CONFIG_RTL8686_DSP_MEM_SIZE 0x01700000
	else
	hex  "RTL8686 CPU MEM Base" CONFIG_RTL8686_CPU_MEM_BASE 0x00000000
	hex  "RTL8686 CPU MEM Size" CONFIG_RTL8686_CPU_MEM_SIZE 0x03800000
	hex  "RTL8686 IPC MEM Base" CONFIG_RTL8686_IPC_MEM_BASE 0x03800000
	hex  "RTL8686 IPC MEM Size" CONFIG_RTL8686_IPC_MEM_SIZE 0x00100000
	hex  "RTL8686 DSP MEM Base" CONFIG_RTL8686_DSP_MEM_BASE 0x03900000
	hex  "RTL8686 DSP MEM Size" CONFIG_RTL8686_DSP_MEM_SIZE 0x00700000
	fi
fi
endmenu
```

## sdk/linux-2.6.x/acmw_lx/Config.in
```kconfig
mainmenu_option next_comment
comment 'AudioCodes VoIP Suite'
bool 'AudioCodes VOIP' CONFIG_AUDIOCODES_VOIP

if [ "$CONFIG_AUDIOCODES_VOIP" == "y" ]; then
   	choice 'SoC Selection' \
	"RTL8186VA	CONFIG_AUDIOCODES_RTL8186VA \
	 RTL8651BV	CONFIG_AUDIOCODES_RTL8651BV \
	 RTL8651C	CONFIG_AUDIOCODES_RTL8651C \
	 RTL8671VA	CONFIG_AUDIOCODES_RTL8671VA" RTL8186VA
	 if [ "$CONFIG_AUDIOCODES_RTL8186VA" == "y" ]; then
	   	define_bool ACL_RTL8186VA y
	 fi
	 if [ "$CONFIG_AUDIOCODES_RTL8651BV" == "y" ]; then
	   	define_bool ACL_RTL8651BV y
	 fi
	 if [ "$CONFIG_AUDIOCODES_RTL8651C" == "y" ]; then
	   	define_bool ACL_RTL8651C y
	 fi
	 if [ "$CONFIG_AUDIOCODES_RTL8671VA" == "y" ]; then
	   	define_bool ACL_RTL8671VA y
	 fi

	 choice 'OS Selection' \
	 "Linux-2.4.18	CONFIG_AUDIOCODES_LINUX_2_4_18 \
	  uCLinux-2.4.x	CONFIG_AUDIOCODES_UCLINUX_2_4_X" Linux-2.4.18

	 if [ "$CONFIG_AUDIOCODES_LINUX_2_4_18" == "y" ]; then
	   	define_bool ACL_LINUX_2_4_18 y
	 fi

	if [ "$CONFIG_AUDIOCODES_UCLINUX_2_4_X" == "y" ]; then
	   	define_bool ACL_UCLINUX_2_4_X y
	 fi



	bool 'AudioCodes VOIP Library Release' CONFIG_AUDIOCODES_VOIP_RELEASE

	if [ "$CONFIG_AUDIOCODES_VOIP_RELEASE" == "y" ]; then
		   define_bool      ACMW_LX y
		   define_bool      AUDIOCODES_VOIP y
		   define_bool      ACL_BYPASS y
		   define_bool      ACL_RELEASE y
		   define_bool      AUDIOCODES_VOIP_SIP y
	else
		bool 'AudioCodes VOIP Release Configuration' CONFIG_AUDIOCODES_VOIP_RELEASE_CONFIG
		define_bool      ACMW_LX y
		define_bool      AUDIOCODES_VOIP y
		define_bool      ACL_BYPASS y

		if [ "$CONFIG_AUDIOCODES_VOIP_RELEASE_CONFIG" == "y" ]; then
		   	define_bool ACL_IBSGEN y
		   	define_bool ACL_IBSDET y
		   	define_bool ACL_G729 y
		   	define_bool ACL_G723 y
		   	define_bool ACL_G711_PLC_ENABLE y
		   	define_bool ACL_G711_CNG_ENABLE y
		   	define_bool ACL_LEC3 y
		   	define_bool ACL_3WCONF y
		   	define_bool ACL_RELAY y
		   	define_bool ACL_ILBC  n
		   	define_bool ACL_GSMFR n
		   	define_bool ACL_AGC y
			define_bool ACL_PLAYBACK y
			define_bool ACL_CID y
		   	define_bool ACL_RAM_LOGGER n
		   	define_bool ACL_DEBUG n
		   	define_bool ACL_PROFILER_STATUS n
		   	define_bool ACL_PROFILER n
		   	define_bool ACL_PROFILER_G729 n
		   	define_bool ACL_PROFILER_G711 n
		   	define_bool ACL_PROFILER_G723 n
		   	define_bool ACL_PROFILER_LEC3 n
		   	define_bool ACL_PROFILER_IBS_GEN n
		   	define_bool ACL_PROFILER_IBS_DET n
		   	define_bool ACL_PROFILER_RELAY n
		   	define_bool ACL_PROFILER_ILBC n
		   	define_bool ACL_PROFILER_GSMFR n
		   	define_bool ACL_PROFILER_AGC n

	   		bool 'AudioCodes with SIP' CONFIG_AUDIOCODES_VOIP_SIP
			if [ "$CONFIG_AUDIOCODES_VOIP_SIP" == "y" ]; then
	   			define_bool AUDIOCODES_VOIP_SIP y
	   		else
	   			define_bool AUDIOCODES_VOIP_SIP n
   			fi

		else
		   comment '--------------- Modules ---------------'
		   bool 'IBS Generator'  CONFIG_ACL_IBSGEN
		   bool 'IBS Detector'   CONFIG_ACL_IBSDET
		   bool 'G729'    	 CONFIG_ACL_G729
		   if [ "$CONFIG_ACL_G729" = "y" ]; then
		         bool '    G711 CNG'         CONFIG_ACL_G711_CNG
		   fi
		   bool 'G723'                       CONFIG_ACL_G723
		   bool 'G711 PLC'                   CONFIG_ACL_G711_PLC
		   bool 'LEC3'                       CONFIG_ACL_LEC3
		   bool '3-Way Conference'           CONFIG_ACL_3WCONF
		   bool 'Fax Relay and Caller ID'    CONFIG_ACL_RELAY
		   bool 'iLBC' 			     CONFIG_ACL_ILBC
		   bool 'GSM-FR' 		     CONFIG_ACL_GSMFR
		   bool 'AGC' 		     		CONFIG_ACL_AGC
		   bool 'Playback' 		     CONFIG_ACL_PLAYBACK
		   bool 'Cid' 		     CONFIG_ACL_CID
		   comment '--------------- QA ----------------------'
		   bool '4 Wire Interface'   	     CONFIG_AUDIOCODES_4W_IF
		   comment '--------------- Utilities ---------------'
		   bool 'RAM Logger'     	     CONFIG_ACL_RAM_LOGGER
		   bool 'Debug tracing'  	     CONFIG_ACL_DEBUG
		   bool 'Profiling & Status tools'     	CONFIG_ACL_PROFILER_STATUS
		   if [ "$CONFIG_ACL_PROFILER_STATUS" = "y" ]; then
   		         bool '  Enable Profiler'         CONFIG_ACL_PROFILER
			   if [ "$CONFIG_ACL_PROFILER" = "y" ]; then
				  comment '----Low Level Profiling-----'
			         bool '   G729'         CONFIG_ACL_PROFILER_G729
			         bool '   G711'         CONFIG_ACL_PROFILER_G711
	      		         bool '   G723'         CONFIG_ACL_PROFILER_G723
			         bool '   LEC3'         CONFIG_ACL_PROFILER_LEC3
			         bool '   IBS Generator'         CONFIG_ACL_PROFILER_IBS_GEN
	      		         bool '   IBS Detection'         CONFIG_ACL_PROFILER_IBS_DET
	      		         bool '   Fax Relay & CID'         CONFIG_ACL_PROFILER_RELAY
	      		         bool '   ILBC'        			 CONFIG_ACL_PROFILER_ILBC
			         bool '   GSM-FR'         		CONFIG_ACL_PROFILER_GSMFR
			         bool '   AGC'         		CONFIG_ACL_PROFILER_AGC
		         fi
      		   fi

		   define_bool      ACMW_LX y
		   define_bool      AUDIOCODES_VOIP y
		   define_bool      ACL_BYPASS y

		   if [ "$CONFIG_ACL_IBSGEN" == "y" ]; then
		   	define_bool ACL_IBSGEN y
		   fi

		   if [ "$CONFIG_ACL_IBSDET" == "y" ]; then
		   	define_bool ACL_IBSDET y
		   fi

		   if [ "$CONFIG_ACL_G729" == "y" ]; then
		   	define_bool ACL_G729 y
		   fi

		   if [ "$CONFIG_ACL_G723" == "y" ]; then
		   	define_bool ACL_G723 y
		   fi

		   if [ "$CONFIG_ACL_G711_PLC" == "y" ]; then
		   	define_bool ACL_G711_PLC_ENABLE y
		   fi

		   if [ "$CONFIG_ACL_G711_CNG" == "y" ]; then
		   	define_bool ACL_G711_CNG_ENABLE y
		   fi

		   if [ "$CONFIG_ACL_LEC3" == "y" ]; then
		   	define_bool ACL_LEC3 y
		   fi

		   if [ "$CONFIG_ACL_3WCONF" == "y" ]; then
		   	define_bool ACL_3WCONF y
		   fi

		   if [ "$CONFIG_ACL_RELAY" == "y" ]; then
		   	define_bool ACL_RELAY y
		   fi

		   if [ "$CONFIG_ACL_ILBC" == "y" ]; then
		   	define_bool ACL_ILBC y
		   fi

		   if [ "$CONFIG_ACL_GSMFR" == "y" ]; then
		   	define_bool ACL_GSMFR y
		   fi

		   if [ "$CONFIG_ACL_AGC" == "y" ]; then
		   	define_bool ACL_AGC y
		   fi

		   if [ "$CONFIG_ACL_PLAYBACK" == "y" ]; then
		   	define_bool ACL_PLAYBACK y
		   fi

		   if [ "$CONFIG_ACL_CID" == "y" ]; then
		   	define_bool ACL_CID y
		   fi
		   
		   if [ "$CONFIG_ACL_RAM_LOGGER" == "y" ]; then
		   	define_bool ACL_RAM_LOGGER y
		   fi

		   if [ "$CONFIG_AUDIOCODES_4W_IF" == "y" ]; then
		   	define_bool AUDIOCODES_4W_IF y
		   fi
		   if [ "$CONFIG_ACL_DEBUG" == "y" ]; then
		   	define_bool ACL_DEBUG y
		   fi

		   if [ "$CONFIG_ACL_PROFILER_STATUS" == "y" ]; then
		   	define_bool ACL_PROFILER_STATUS y
		   fi

		   if [ "$CONFIG_ACL_PROFILER" == "y" ]; then
		   	define_bool ACL_PROFILER y
		   fi

		   if [ "$CONFIG_ACL_PROFILER_G729" == "y" ]; then
		   	define_bool ACL_PROFILER_G729 y
		   fi

		   if [ "$CONFIG_ACL_PROFILER_G711" == "y" ]; then
		   	define_bool ACL_PROFILER_G711 y
		   fi

		   if [ "$CONFIG_ACL_PROFILER_G723" == "y" ]; then
		   	define_bool ACL_PROFILER_G723 y
		   fi

		   if [ "$CONFIG_ACL_PROFILER_LEC3" == "y" ]; then
		   	define_bool ACL_PROFILER_LEC3 y
		   fi

		   if [ "$CONFIG_ACL_PROFILER_IBS_GEN" == "y" ]; then
		   	define_bool ACL_PROFILER_IBS_GEN y
		   fi

		   if [ "$CONFIG_ACL_PROFILER_IBS_DET" == "y" ]; then
		   	define_bool ACL_PROFILER_IBS_DET y
		   fi

		   if [ "$CONFIG_ACL_PROFILER_RELAY" == "y" ]; then
		   	define_bool ACL_PROFILER_RELAY y
		   fi

		   if [ "$CONFIG_ACL_PROFILER_ILBC" == "y" ]; then
		   	define_bool ACL_PROFILER_ILBC y
		   fi

		   if [ "$CONFIG_ACL_PROFILER_GSMFR" == "y" ]; then
		   	define_bool ACL_PROFILER_GSMFR y
		   fi
  		   if [ "$CONFIG_ACL_PROFILER_AGC" == "y" ]; then
		   	define_bool ACL_PROFILER_AGC y
		   fi

		fi
	fi
fi

endmenu
```
